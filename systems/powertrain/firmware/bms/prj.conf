## CMakeLists.txt
```
cmake_minimum_required(VERSION 3.20.0)

find_package(Zephyr REQUIRED HINTS $ENV{ZEPHYR_BASE})
project(bms)

target_sources(app PRIVATE src/main.c)

# ---------------------------------------------------------------------------
# Defeat the linker.
#
# Zephyr compiles with -fdata-sections and links with --gc-sections, so every
# global lands in its own section and the linker discards any section no root
# reaches. `volatile` does not prevent this: volatile constrains the compiler,
# and the collection happens in the linker.
#
# A discarded injection target has no address. The harness would have nothing to
# write to, the fault would never be injected, the firmware would behave
# correctly for the input it actually received, and the campaign would report
# PASS. A false negative in a verification tool is the worst class of bug this
# project can have, so there are two independent defences and neither is trusted
# alone:
#
#   1. this file adds -Wl,--undefined=<symbol> per symbol, which makes the
#      linker treat the symbol as an undefined reference from the start and
#      therefore as a garbage-collection root;
#   2. scripts/check_symbols.py reads the produced ELF and fails the build if
#      any listed symbol is absent, has address zero, or has size zero.
#
# Both are driven from the same list, injectable_symbols.txt, so the two
# defences can never disagree about what they are protecting.
# ---------------------------------------------------------------------------

set(INJECTABLE_SYMBOLS_FILE "${CMAKE_CURRENT_SOURCE_DIR}/injectable_symbols.txt")

if(NOT EXISTS "${INJECTABLE_SYMBOLS_FILE}")
  message(FATAL_ERROR
    "injectable_symbols.txt is missing at ${INJECTABLE_SYMBOLS_FILE}.\n"
    "It is the single list that drives both the --undefined link flags and the\n"
    "post-link symbol gate. Building without it would produce a binary whose\n"
    "injection targets are unprotected and unchecked, so the build stops here.")
endif()

file(STRINGS "${INJECTABLE_SYMBOLS_FILE}" _raw_symbol_lines)

set(_kept_symbols "")
foreach(_line IN LISTS _raw_symbol_lines)
  string(STRIP "${_line}" _sym)
  if(_sym STREQUAL "" OR _sym MATCHES "^#")
    continue()
  endif()
  # The file carries "<symbol> <unit> <min> <max> [flags]". Only the first field
  # is the symbol name. Symbols flagged not-injectable are still force-kept and
  # still gated: the linker-collection negative control depends on that.
  string(REGEX REPLACE "^([^ \t]+).*$" "\\1" _sym "${_sym}")

  # DETECT_OMIT_UNDEFINED exists solely so the guard can be seen to fire. It
  # names one symbol whose --undefined flag is deliberately withheld, which for
  # the unreferenced canary means the linker collects it and the symbol gate
  # must fail. It is never set by a normal build.
  if(DEFINED DETECT_OMIT_UNDEFINED AND "${_sym}" STREQUAL "${DETECT_OMIT_UNDEFINED}")
    message(WARNING
      "DETECT: deliberately omitting -Wl,--undefined=${_sym}. "
      "This build is the negative control for the symbol gate and must fail it.")
  else()
    zephyr_link_libraries(-Wl,--undefined=${_sym})
    list(APPEND _kept_symbols "${_sym}")
  endif()
endforeach()

if(_kept_symbols STREQUAL "")
  message(FATAL_ERROR
    "injectable_symbols.txt yielded no symbols. Refusing to link a binary with\n"
    "no protected injection targets rather than silently producing one.")
endif()

message(STATUS "DETECT: forcing retention of: ${_kept_symbols}")
```

## prj.conf
```kconfig
# BMS - Phase 0 configuration.
#
# Console over UART. Zephyr's nucleo_h743zi board definition already selects
# usart3 as `zephyr,console`, the instance wired to the ST-Link virtual COM port
# on real hardware and the instance the harness taps in the emulator.
CONFIG_PRINTK=y
CONFIG_CONSOLE=y
CONFIG_SERIAL=y
CONFIG_UART_CONSOLE=y

# CAN. The board's `zephyr,canbus` chosen node is already fdcan1; the overlay
# only sets the bit rate and marks it okay.
CONFIG_CAN=y

# ---------------------------------------------------------------------------
# Determinism.
#
# The exit criterion is a byte-identical sha256 of the console capture across
# runs, so every source of run-varying console text is switched off here rather
# than filtered out afterwards. Filtering hides a real problem; disabling
# removes it.
# ---------------------------------------------------------------------------

# The boot banner is kept. Its text is "*** Booting Zephyr OS build
# zephyr-v3.5.0 ***", which is a constant string baked in at build time from the
# pinned tag, not a timestamp. It is useful evidence that the pinned Zephyr is
# the one that ran, and it is stable across a clean rebuild of the same tree.
CONFIG_BOOT_BANNER=y

# Logging is left off entirely. The log subsystem prefixes messages with an
# uptime timestamp, and although that timestamp is derived from virtual time and
# would in principle be reproducible, it is one more thing that has to stay
# reproducible for the hash to hold. printk goes straight to the console with no
# prefix, so there is nothing to keep stable.
CONFIG_LOG=n

# Timeslicing off: with it on, the scheduler can preempt at a tick boundary and
# reorder work between equal-priority threads. This build has one application
# thread, so it changes nothing today, and it removes a scheduling degree of
# freedom before Phase 1 adds threads that would be affected.
CONFIG_TIMESLICING=n

# Assertions on. This is the same binary shape that later phases test, not a
# special emulator build. The claim of the project is that the binary under test
# is the binary that would ship.
CONFIG_ASSERT=y
```

## boards/nucleo_h743zi.overlay
```dts
/*
 * BMS devicetree overlay for nucleo_h743zi.
 *
 * The board's own .dts already does two things this file therefore does not
 * repeat: it selects the CAN controller with `zephyr,canbus = &fdcan1` in
 * /chosen, and it assigns the pins with
 * `pinctrl-0 = <&fdcan1_rx_pd0 &fdcan1_tx_pd1>`.
 *
 * What is left is the bit rate and enabling the node. `bus-speed` is the
 * property name in the can-controller binding at Zephyr v3.5.0; it is not
 * `bitrate`, and a wrong property name here is silently ignored by the
 * devicetree compiler rather than reported, which is why it is called out.
 *
 * 500000 bit/s is the powertrain domain's CAN 2.0B rate.
 */

&fdcan1 {
	bus-speed = <500000>;
	status = "okay";
};
```

## src/main.c
```c
/*
 * BMS - battery management system, the device under test.
 *
 * Phase 1 scope: boot, expose the injection targets, implement ONE safety
 * function, and publish a status frame the harness can assert against.
 *
 * The single safety function here is over-temperature protection. Phase 2 adds
 * the other seven. It exists now because Phase 1 needs a real rule to build the
 * canary defect against: inverting its comparison from > to >= is the whole
 * basis of the engine's red/green test.
 *
 * Determinism is load bearing. Every timing result in the paper rests on two
 * runs producing byte-identical console output, so this file contains,
 * deliberately:
 *
 *   no wall-clock reads   nothing calls k_uptime_get(), and nothing prints a
 *                         time. The tick counter is a pure count of loop
 *                         iterations, not a measurement of elapsed time.
 *   no floating point     every printed and transmitted value is an integer.
 *   no randomness         no entropy source, no hashed pointer, no address.
 */

#include <zephyr/kernel.h>
#include <zephyr/sys/printk.h>
#include <zephyr/device.h>
#include <zephyr/drivers/can.h>
#include <stdint.h>

/* Status frame. The signal layout is declared in systems/powertrain/catalog.yml
 * and must match it byte for byte; the catalogue is the contract, this is one
 * implementation of it. */
#define BMS_STATUS_ID   0x604U

/* The peer's heartbeat. The BMS counts these so that peer-loss supervision has
 * something to supervise; a later requirement family depends on it. */
#define VCU_STATUS_ID   0x605U

/* Fault codes. Mirrors the fault_code enum in the catalogue. */
#define FAULT_NONE      0U
#define FAULT_OVERTEMP  1U

/*
 * Over-temperature limit, in tenths of a degree Celsius.
 *
 * The comparison below is STRICT. A reading exactly at the limit is legal and
 * must not raise a fault; only a reading above it may. That single character is
 * what the canary defect inverts, and the difference is observable at exactly
 * one input value.
 */
#define OVERTEMP_LIMIT_dC   550

/* Fixed tick. A loop period expressed as a constant, never as a measured
 * interval, so the schedule is identical on every run. */
#define TICK_MS         100U
#define REPORT_EVERY    10U      /* one console report per second */

/* ---------------------------------------------------------------------------
 * Injection targets.
 *
 * The harness resolves each of these through the ELF symbol table and writes the
 * running machine's memory directly. At instruction level the firmware cannot
 * distinguish that from a sensor driver's write.
 *
 * g_pack_mv is uint32_t, not uint16_t. In millivolts a 16-bit field caps at
 * 65.535 V, and this project's powertrain pack is a high-voltage one: 400 V is
 * 400000 mV, which wraps to 7616 in 16 bits. That wrap would look exactly like a
 * planted defect, and it would be in the GOLDEN firmware, contaminating every
 * voltage result in the paper. The unit stays millivolts; the type is widened.
 *
 * `volatile` forces a real load on every loop iteration so the compiler cannot
 * cache a value in a register across the sleep. It does NOT protect the symbol
 * from the linker; see injectable_symbols.txt and CMakeLists.txt.
 * ------------------------------------------------------------------------- */
volatile int16_t  g_cell_temp_dC = 250;    /* tenths of a degree C, 25.0 C     */
volatile uint32_t g_pack_mv      = 48000;  /* millivolts                       */
volatile int16_t  g_pack_ma      = -5000;  /* milliamps, signed: negative is
                                              discharge                        */
volatile uint8_t  g_tx_enable    = 1;      /* transmit enable                  */

/* ---------------------------------------------------------------------------
 * Garbage-collection canary.
 *
 * Referenced by NOTHING. No line of C reads or writes it. It survives the link
 * only because of its -Wl,--undefined flag, which makes it the negative control
 * for the symbol gate: withholding that one flag lets the linker discard it and
 * the gate must then refuse the binary. It is not an injection target and is
 * marked not-injectable in injectable_symbols.txt.
 * ------------------------------------------------------------------------- */
volatile uint32_t g_gc_canary = 0xC0DEC0DEU;

static const struct device *const can_dev =
	DEVICE_DT_GET(DT_CHOSEN(zephyr_canbus));

/* Written from the receive callback, read from the main loop. */
static volatile uint32_t s_rx_count;

static void vcu_rx_cb(const struct device *dev, struct can_frame *frame,
		      void *user_data)
{
	ARG_UNUSED(dev);
	ARG_UNUSED(frame);
	ARG_UNUSED(user_data);
	s_rx_count++;
}

/* Latched fault state. Once raised it is never cleared here; clearing on reset
 * only is the behaviour the requirement describes, and a later defect family
 * attacks exactly that. */
static uint8_t s_fault_code = FAULT_NONE;

int main(void)
{
	uint32_t tick = 0U;
	uint8_t  rolling = 0U;
	int can_rc;

	/* Printed before anything that can fail, so a CAN problem is diagnosed as
	 * a CAN problem and never as a dead console. */
	printk("BMS ready\n");

	if (!device_is_ready(can_dev)) {
		printk("bms FATAL can device not ready\n");
		return -1;
	}

	{
		/*
		 * CAN_FILTER_DATA is REQUIRED.
		 *
		 * At Zephyr 3.5 a filter with flags = 0 matches nothing at all.
		 * The node boots, announces itself, and receives not one frame,
		 * which is indistinguishable from a peer that never transmitted.
		 * If the receive count stays at zero, check this flag before
		 * suspecting the peer, the hub, or the bit rate.
		 */
		const struct can_filter filter = {
			.id    = VCU_STATUS_ID,
			.mask  = CAN_STD_ID_MASK,
			.flags = CAN_FILTER_DATA,
		};
		int filter_id = can_add_rx_filter(can_dev, vcu_rx_cb, NULL, &filter);

		printk("bms add_rx_filter rc=%d\n", filter_id);
	}

	can_rc = can_start(can_dev);
	printk("bms can_start rc=%d\n", can_rc);

	while (1) {
		/* Read every injection target on every iteration, so an injected
		 * write becomes observable on the next tick. */
		int16_t  temp_dC = g_cell_temp_dC;
		uint32_t pack_mv = g_pack_mv;
		int16_t  pack_ma = g_pack_ma;
		uint8_t  tx_on   = g_tx_enable;

		/* --- SAFETY FUNCTION: over-temperature protection ---------------
		 * Strict comparison. At exactly the limit the reading is legal.
		 * Latched: once set, it stays set. */
		if (temp_dC > OVERTEMP_LIMIT_dC) {
			s_fault_code = FAULT_OVERTEMP;
		}

		{
			struct can_frame frame = {
				.id    = BMS_STATUS_ID,
				.dlc   = 8U,
				.flags = 0U,
			};
			uint8_t sum = 0U;
			int i;
			int tx_rc = 0;

			/* Little-endian bit packing, matching catalog.yml:
			 *   fault_code       start_bit  0, length  8  -> byte 0
			 *   pack_mv          start_bit  8, length 24  -> bytes 1..3
			 *   pack_ma          start_bit 32, length 16  -> bytes 4..5, signed
			 *   rolling_counter  start_bit 48, length  4  -> byte 6, low nibble
			 *   checksum         start_bit 56, length  8  -> byte 7
			 */
			frame.data[0] = s_fault_code;
			frame.data[1] = (uint8_t)(pack_mv & 0xFFU);
			frame.data[2] = (uint8_t)((pack_mv >> 8) & 0xFFU);
			frame.data[3] = (uint8_t)((pack_mv >> 16) & 0xFFU);
			frame.data[4] = (uint8_t)((uint16_t)pack_ma & 0xFFU);
			frame.data[5] = (uint8_t)(((uint16_t)pack_ma >> 8) & 0xFFU);
			frame.data[6] = (uint8_t)(rolling & 0x0FU);

			/* Checksum over the preceding seven bytes. A later defect
			 * family changes this range. */
			for (i = 0; i < 7; i++) {
				sum = (uint8_t)(sum + frame.data[i]);
			}
			frame.data[7] = sum;

			if (tx_on) {
				tx_rc = can_send(can_dev, &frame, K_MSEC(50),
						 NULL, NULL);
			}

			/* The rolling counter advances on every transmission
			 * attempt, which is exactly why assertions must match on
			 * (value, mask) and never on equality. */
			rolling = (uint8_t)((rolling + 1U) & 0x0FU);

			if ((tick % REPORT_EVERY) == 0U) {
				printk("bms tick=%u temp_dC=%d pack_mv=%u pack_ma=%d "
				       "fault=%u tx=%u txrc=%d rx_from_vcu=%u\n",
				       tick, (int)temp_dC, (unsigned int)pack_mv,
				       (int)pack_ma, (unsigned int)s_fault_code,
				       (unsigned int)tx_on, tx_rc,
				       (unsigned int)s_rx_count);
			}
		}

		tick++;
		k_sleep(K_MSEC(TICK_MS));
	}

	return 0;
}
```
